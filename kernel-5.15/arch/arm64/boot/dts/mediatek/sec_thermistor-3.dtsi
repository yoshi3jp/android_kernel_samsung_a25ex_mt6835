/ {
	fragment@smd {
		target-path = "/";
		__overlay__ {
			samsung_mobile_device {
				sec_pa_thermistor: sec_thermistor@3 {
					compatible = "samsung,sec-thermistor";
					status = "okay";
					thermistor_name = "sec-pa-thermistor";
					id = <3>;

					io-channels = SEC_ADC(tia_auxadc,0x01);
					io-channel-names = "pa_therm";
					io-channel-ranges;
				};
			};
		};
	};
};
