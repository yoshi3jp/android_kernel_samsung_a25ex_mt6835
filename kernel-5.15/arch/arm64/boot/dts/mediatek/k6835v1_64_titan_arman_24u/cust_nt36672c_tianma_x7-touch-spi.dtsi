// SPDX-License-Identifier: (GPL-2.0 OR MIT)
/*
 * Copyright (C) 2024 MediaTek Inc.
 */

&spi7 {
	status = "okay";

	/* Novatek device tree node */
	novatek@0 {
		compatible = "novatek,NVT-ts-spi";
		reg = <0>; //Same as CS ID
		status = "okay";

		spi-max-frequency = <9600000>;	//4800000,9600000,15000000,19200000
		novatek,reset-gpio = <&pio 9 0x00>;
		novatek,irq-gpio = <&pio 14 0x2001>;
		novatek,firmware-name = "novatek_tianma_ts_fw_x7.bin";

		//novatek,pen-support;
		//novatek,stylus-resol-double;

		/* 525 */
		//novatek,swrst-n8-addr = <0x01f01a>;

		/* 672A, 525B, 675, 526, 672C, 523 */
		novatek,swrst-n8-addr = <0x03f0fe>;
		novatek,spi-rd-fast-addr = <0x03f310>;

		/* MP */
		//novatek,mp-support-dt;
	};
};
