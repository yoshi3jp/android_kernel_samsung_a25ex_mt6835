/ {
	fragment@smd {
		target-path = "/";
		__overlay__ {
			samsung_mobile_device {
				sec_cp_thermistor: sec_thermistor@1 {
					compatible = "samsung,sec-thermistor";
					status = "okay";
					thermistor_name = "sec-cp-thermistor";
					id = <1>;

					io-channels = SEC_ADC(tia_auxadc,0x02);
					io-channel-names = "cp_therm";
					io-channel-ranges;
				};
			};
		};
	};
};
