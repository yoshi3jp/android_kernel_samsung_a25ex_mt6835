## custom_defconfigs/version_defconfig
```kconfig
CONFIG_LOCALVERSION_AUTO=n
CONFIG_LOCALVERSION="-Ubuntu-LXC-Docker-ravindu644-dev"
```

## kernel-5.15/arch/arm64/configs/lego_defconfig
```kconfig
CONFIG_SEC_PANEL_NOTIFIER_V2=m
# CONFIG_SECURITY_DEFEX is not set
CONFIG_INPUT_SEC_INPUT=m
CONFIG_INPUT_SEC_NOTIFIER=m
CONFIG_SEC_DEBUG_TSP_LOG=m
CONFIG_TOUCHSCREEN_DUMP_MODE=m
CONFIG_SEC_INPUT_HEADER=y
# CONFIG_INPUT_SEC_SECURE_TOUCH is not set
# CONFIG_INPUT_SEC_TRUSTED_TOUCH is not set
# CONFIG_INPUT_TOUCHSCREEN_TCLMV2 is not set
# CONFIG_SEC_INPUT_MULTI_DEVICE is not set
# CONFIG_SEC_INPUT_RAWDATA is not set
CONFIG_VIBRATOR_VIB_INFO=m
CONFIG_IIO=y
CONFIG_IIO_BUFFER=y
CONFIG_SHUB=m
CONFIG_SEC_NFC_LOGGER=y
# CONFIG_SECURITY_DSMS is not set
CONFIG_DEV_RIL_BRIDGE=m
CONFIG_SEC_VIBRATOR=m
CONFIG_SEC_MTK_CHARGER=m
CONFIG_MUIC_NOTIFIER=m
CONFIG_HICCUP_CC_DISABLE=y
CONFIG_HICCUP_CHARGER=y
CONFIG_MUIC_COMMON_SYSFS=y
CONFIG_MUIC_AFC_RETRY=y
CONFIG_MUIC_HV=y
CONFIG_MUIC_SUPPORT_PDIC=y
CONFIG_MUIC_USE_MODULE_PARAM=y
CONFIG_USE_MUIC=y
CONFIG_SEC_STI=y
CONFIG_USB_NOTIFY_LAYER=m
CONFIG_USB_DEBUG_DETAILED_LOG=y
CONFIG_USB_EXTERNAL_NOTIFY=y
CONFIG_USB_HMT_SAMSUNG_INPUT=y
CONFIG_USB_HOST_NOTIFY=y
CONFIG_USB_HOST_SAMSUNG_FEATURE=y
CONFIG_USB_HW_PARAM=y
CONFIG_USB_INTERFACE_LPM_LIST=y
CONFIG_USB_NOTIFY_PROC_LOG=y
CONFIG_USB_USING_ADVANCED_USBLOG=y
CONFIG_SEC_INPUT_BOOSTER=m
# CONFIG_SEC_INPUT_BOOSTER_MODE is not set
CONFIG_SEC_INPUT_BOOSTER_MTK=y
CONFIG_SEC_INPUT_BOOSTER_HANDLER=y
CONFIG_SB_CORE=m
CONFIG_SB_PQUEUE=y
CONFIG_SB_NOTIFY=y
CONFIG_SB_SYSFS=y
CONFIG_SB_VOTE=y
CONFIG_VBUS_NOTIFIER=m
CONFIG_USB_TYPEC_MANAGER_NOTIFIER=m
CONFIG_IF_CB_MANAGER=m
CONFIG_SENSORS_FINGERPRINT=m
CONFIG_FUELGAUGE_MTK=m
CONFIG_USDM_PANEL_TFT_COMMON=m
CONFIG_USDM_PANEL_NT36528A_A25EX_00=m
CONFIG_SEC_ABC_SPEC_TYPE1=m
CONFIG_SHUB_MODULE=y
CONFIG_SHUB_AP_STATUS_CMD=y
CONFIG_SHUB_MTK=y
CONFIG_DRM_PANEL_MCD_COMMON=m
# CONFIG_DRM_PANEL_SAMSUNG_COMMON is not set
CONFIG_PDIC_NOTIFIER=m
CONFIG_PDIC_USE_MODULE_PARAM=y
CONFIG_VIRTUAL_MUIC=m
CONFIG_SEC_ABC=m
CONFIG_SEC_ABC_HUB=m
CONFIG_SEC_ABC_COMMON=m
CONFIG_SEC_ABC_HUB_CORE=m
CONFIG_SEC_ABC_HUB_BOOTC=m
CONFIG_SEC_ABC_MOTTO=m
CONFIG_USB_NOTIFIER=m
CONFIG_BATTERY_SAMSUNG=m
CONFIG_SEC_PD=m
CONFIG_BATTERY_GKI=y
CONFIG_BATTERY_AGE_FORECAST=y
CONFIG_BATTERY_CISD=y
CONFIG_AFC_CHARGER_MODE=y
CONFIG_BATTERY_LOGGING=y
CONFIG_ENABLE_FULL_BY_SOC=y
CONFIG_STEP_CHARGING=y
CONFIG_SUPPORT_HV_CTRL=y
CONFIG_USB_FACTORY_MODE=y
CONFIG_I2C_GPIO=m
CONFIG_SEC_PM_THERMISTOR=m
CONFIG_TOUCHSCREEN_NOVATEK_NT36XXX_SPI=m
CONFIG_REGULATOR_FIXED_VOLTAGE=y
CONFIG_SENSORS_GW3X=m
CONFIG_SENSORS_FINGERPRINT_MODULE=y
CONFIG_FINGERPRINT_SECURE=y
CONFIG_SENSORS_FINGERPRINT_MTK=y
# CONFIG_SENSORS_FINGERPRINT_NORMALSPI is not set
# CONFIG_SENSORS_FINGERPRINT_32BITS_PLATFORM_ONLY is not set
CONFIG_STAR_K250A_LEGO=m
CONFIG_SEC_SNVM_PLATFORM_DRV=y
CONFIG_SEC_SNVM_I2C_CLOCK_CONTROL=y
CONFIG_SEC_SNVM_WAKELOCK_METHOD=2
# CONFIG_STAR_MEMORY_LEAK is not set
CONFIG_DC_VIBRATOR=m
# CONFIG_MTK_VIBRATOR is not set
CONFIG_SAMSUNG_NFC=m
CONFIG_SEC_MX_NFC=y
CONFIG_MTK_NFC_CLKBUF_ENABLE=y
CONFIG_MTK_CLKBUF_NFC=y
# CONFIG_SEC_NFC_EINT_EXYNOS is not set
CONFIG_SEC_NFC_WAKELOCK_METHOD=2
CONFIG_SEC_NFC_DUPLICATED_IRQ_WQ_LSI=y
# CONFIG_SEC_NFC_TEST_ON_PROBE is not set
CONFIG_ESE_P3_LSI=y
CONFIG_ESE_COLDRESET=y
# CONFIG_ESE_USE_REGULATOR is not set
# CONFIG_MAKE_NODE_USING_PLATFORM_DEVICE is not set
CONFIG_SENSORS_SUPPORT_MTK=y
CONFIG_SENSORS_ISG5320A=m
CONFIG_SENSORS_ISG5320A_SUB=y
# CONFIG_TEST_FOR_GRIP is not set
# CONFIG_SENSORS_CORE_AP is not set
CONFIG_SENSORS_GRIP_FAILURE_DEBUG=y
```

## kernel-5.15/drivers/gpu/drm/samsung/panel/tft_common/Kconfig
```kconfig
menuconfig USDM_PANEL_TFT_COMMON
	tristate "TFT_COMMON DDI Panel Driver"
	depends on USDM_PANEL
	default n
	help
		This enables TFT_COMMON DDI dependent panel drivers of
		common panel driver. say Y, if you have a panel based on
		the TFT_COMMON DDI.


########## FOR KUNIT ##########

config TFT_COMMON_TEST
	bool "KUnit test for tft_common ddi driver"
	depends on SEC_KUNIT
	help
	  TODO: Describe config fully.

menuconfig USDM_PANEL_NT36528A_A25EX_00
	tristate "NT36528A_A25EX_00 DDI Panel Driver"
	depends on USDM_PANEL_TFT_COMMON
	default n
	help
		This enables NT36528A_A25EX_00 DDI dependent panel drivers of
		common panel driver. say Y, if you have a panel based on
		the NT36528A_A25EX_00 DDI.

########## FOR KUNIT ##########

config NT36528A_A25EX_00_TEST
	bool "KUnit test for tft_common ddi driver"
	depends on SEC_KUNIT
	help
	  TODO: Describe config fully.
```
